## meta-fermentation-monitor/conf/layer.conf
```bitbake
# We have a conf and classes directory, add to BBPATH
BBPATH .= ":${LAYERDIR}"

# We have recipes-* directories, add to BBFILES
BBFILES += "${LAYERDIR}/recipes-*/*/*.bb \
            ${LAYERDIR}/recipes-*/*/*.bbappend"

BBFILE_COLLECTIONS += "meta-fermentation-monitor"
BBFILE_PATTERN_meta-fermentation-monitor = "^${LAYERDIR}/"
BBFILE_PRIORITY_meta-fermentation-monitor = "6"

LAYERDEPENDS_meta-fermentation-monitor = "core openembedded-layer meta-python networking-layer"
LAYERSERIES_COMPAT_meta-fermentation-monitor = "scarthgap"
```
